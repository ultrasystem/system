## arch/arm/mach-omap2/Kconfig.rej
```kconfig
***************
*** 45,50 ****
  	select USB_ARCH_HAS_EHCI if USB_SUPPORT
  	select ARM_ERRATA_754322
  	select ARM_ERRATA_775420
  
  config SOC_OMAP5
  	bool "TI OMAP5"
--- 45,51 ----
  	select USB_ARCH_HAS_EHCI if USB_SUPPORT
  	select ARM_ERRATA_754322
  	select ARM_ERRATA_775420
+ 	select ARM_GLOBAL_TIMER if IPIPE && SMP
  
  config SOC_OMAP5
  	bool "TI OMAP5"
```
